## conf/layer.conf
```bitbake
BBPATH .= ":${LAYERDIR}"

BBFILES += "${LAYERDIR}/recipes-*/*/*.bb \
            ${LAYERDIR}/recipes-*/*/*.bbappend"

BBFILE_COLLECTIONS += "meta-argus-bsp"
BBFILE_PATTERN_meta-argus-bsp = "^${LAYERDIR}/"
BBFILE_PRIORITY_meta-argus-bsp = "10"

LAYERDEPENDS_meta-argus-bsp = "core meta-argus"
LAYERSERIES_COMPAT_meta-argus-bsp = "kirkstone"
```

## conf/machine/argus-qemuarm.conf
```bitbake
EXTRA_IMAGEDEPENDS += "virtual/bootloader"
PREFERRED_PROVIDER_virtual/bootloader = "u-boot"

UBOOT_LOADADDRESS = "0x40400000"
UBOOT_ENTRYPOINT = "0x40400000"
UBOOT_DTB_LOADADDRESS = "0x40000000"
UBOOT_RD_LOADADDRESS = "0x44000000"

KERNEL_DEVICETREE = "qemuarm.dtb"

IMAGE_BOOT_FILES = "\
    boot.scr \
    fitImage-${INITRAMFS_IMAGE}-${MACHINE}-${MACHINE};fitImage \
"

WKS_FILE = "argus-qemuarm.wks"
QB_DEFAULT_FSTYPE = "wic"
QB_DEFAULT_BIOS = "u-boot.bin"
QB_DRIVE_TYPE = "/dev/vdb"
```

## wic/argus-qemuarm.wks
```
part /boot --source bootimg-partition --ondisk sda --fstype=ext4 --use-uuid --label boot --active --align 1024
part / --source rawcopy --ondisk sda --sourceparams="file=${IMGDEPLOYDIR}/${DM_VERITY_IMAGE}-${MACHINE}.${DM_VERITY_IMAGE_TYPE}.verity"
part --source rawcopy --ondisk sda --sourceparams="file=${IMGDEPLOYDIR}/${DM_VERITY_IMAGE}-${MACHINE}.${DM_VERITY_IMAGE_TYPE}.verity"
part /data --ondisk sda --use-uuid --fstype=ext4 --label data --fixed-size 512M
```

## wic/argus-qemux86-64.wks
```
part /boot --source bootimg-pcbios --ondisk sda --label boot --active --align 1024
part / --source rootfs --use-uuid --ondisk sda --fstype=squashfs --fixed-size 256M
part --source rootfs --use-uuid --ondisk sda --fstype=squashfs --fixed-size 256M
part /data --ondisk sda --use-uuid --fstype=ext4 --label data --fixed-size 512M
bootloader --timeout=0 --append="console=ttyS0 console=tty1 rootfstype=squashfs"
```
